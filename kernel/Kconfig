## kernel/Kconfig
```kconfig
config ENCORE_FAS
	tristate "Encore Tweaks FAS kernel module"
	depends on ARM64 && UPROBES
	default n
	help
	  Frame aware scheduling driver for Encore Tweaks (/dev/encore_fas).
	  Say N unless you build a daemon that uses this module.
```
